## meta-pwl-custom/conf/layer.conf
```bitbake
# We have a conf and classes directory, add to BBPATH
BBPATH .= ":${LAYERDIR}"

# We have recipes-* directories, add to BBFILES
BBFILES += "${LAYERDIR}/recipes-*/*/*.bb \
            ${LAYERDIR}/recipes-*/*/*.bbappend"

BBFILE_COLLECTIONS += "meta-pwl-custom"
BBFILE_PATTERN_meta-pwl-custom = "^${LAYERDIR}/"
BBFILE_PRIORITY_meta-pwl-custom = "6"

LAYERDEPENDS_meta-pwl-custom = "core"
LAYERSERIES_COMPAT_meta-pwl-custom = "kirkstone"
IMAGE_INSTALL:append = " floppymonitor ramblerapps autofs python3 python3-pillow ghostscript packagegroup-fonts-truetype-core imagemagick liberation-fonts fontconfig "
```

## meta-pwl-it8951/conf/layer.conf
```bitbake
# We have a conf and classes directory, add to BBPATH
BBPATH .= ":${LAYERDIR}"

# We have recipes-* directories, add to BBFILES
BBFILES += "${LAYERDIR}/recipes-*/*/*.bb \
            ${LAYERDIR}/recipes-*/*/*.bbappend"

BBFILE_COLLECTIONS += " meta-pwl-it8951 "
BBFILE_PATTERN_meta-pwl-it8951 = "^${LAYERDIR}/"
BBFILE_PRIORITY_meta-pwl-it8951 = "9"

LAYERDEPENDS_meta-pwl-it8951 = "core"
LAYERSERIES_COMPAT_meta-pwl-it8951 = "kirkstone"

IMAGE_INSTALL:append = " it8951 " 
```
